## main/Kconfig.projbuild
```kconfig
menu "ProgressBar Configuration"

    config WIFI_AP_NAME
        string "WiFi AP Name"
        default ""
        help
            WiFi access point name.

    config WIFI_AP_PASS
        string "WiFi AP Password"
        default ""
        help
            WiFi access point password.

    menu "Payment Backend"

        config API_SERVER_ADDR
            string "API Server Address"
            default "payment.example.org"
            help
                The address of the web server that hosts the payment backend.

        config API_SERVER_PORT
            int "API Server Port"
            default 80
            help
                Port on which the api web server listens.

        config API_SERVER_PATH
            string "API Server Path"
            default "/api/charge"
            help
                Path on which to reach the payment api.

    endmenu

    menu "Screen Backend"

        config SCREEN_SERVER_ADDR
            string "Screen Server Address"
            default "screen.example.org"
            help
                The address of the web server that hosts the screen backend.

        config SCREEN_SERVER_PORT
            int "Screen Server Port"
            default 80
            help
                Port on which the screen web server listens.

        config SCREEN_SERVER_PATH
            string "Screen Server Path"
            default "/"
            help
                Path on which to query the screen api.

    endmenu

endmenu
```

## sdkconfig.defaults
```kconfig
CONFIG_APP_REPRODUCIBLE_BUILD=y
CONFIG_IDF_CMAKE=y
CONFIG_IDF_TARGET_ARCH_RISCV=y
CONFIG_IDF_TARGET="esp32c3"
CONFIG_IDF_TARGET_ESP32C3=y
CONFIG_IDF_FIRMWARE_CHIP_ID=0x0005
CONFIG_SDK_TOOLPREFIX="riscv32-esp-elf-"
CONFIG_COMPILER_OPTIMIZATION_PERF=y
CONFIG_COMPILER_STACK_CHECK_MODE_STRONG=y
CONFIG_COMPILER_WARN_WRITE_STRINGS=y
CONFIG_COMPILER_SAVE_RESTORE_LIBCALLS=y
# CONFIG_ETH_USE_SPI_ETHERNET is not set
CONFIG_PM_ENABLE=y
CONFIG_ESP_MAIN_TASK_STACK_SIZE=7000
CONFIG_ESP_WIFI_SLP_IRAM_OPT=y
CONFIG_ESP_WIFI_STA_DISCONNECTED_PM_ENABLE=y
# CONFIG_ESP_WIFI_SOFTAP_SUPPORT is not set
CONFIG_ESP_WIFI_SLP_BEACON_LOST_OPT=y
CONFIG_ESP_COREDUMP_ENABLE_TO_UART=y
CONFIG_FREERTOS_HZ=1000
CONFIG_FREERTOS_USE_TICKLESS_IDLE=y
CONFIG_FREERTOS_WATCHPOINT_END_OF_STACK=y
CONFIG_HEAP_POISONING_LIGHT=y
```
